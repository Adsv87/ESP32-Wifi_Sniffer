## Neuer Ordner/Kconfig.projbuild
```kconfig
menu "Configuration"

config ETS
	string "Main topic"
	default "ETS"
	help
		Name of main topic

config ESP32_ID
	string "ESP32 ID"
	default "ESP32-A"
	help
		ID of the ESP32. Must be univoque

config ROOM
	string "Room"
	default "1"
	help
		Room in which ESP32 is situated

config WIFI_SSID
    string "WiFi SSID"
    default ""
    help
		SSID of WiFi (network name)

config WIFI_PSW
    string "WiFi password"
    default ""
    help
		WiFi password (WPA or WPA2), can be left blank if the network has no security set

config BROKER_ADDR
	string "MQTT broker address"
	default ""
	help
		IP of the broker mqtt. Check documentation for more info

config BROKER_PSW
	string "MQTT broker password"
	default ""
	help
		Password of the MQTT server, can be left blank if the network has no security set

config BROKER_PORT
	int "MQTT broker port"
	range 1 65535
	default 1883
	help
		The port of the server MQTT

config CHANNEL
	int "Sniffing channel"
	range 1 13
	default 11
	help
		Channel in which ESP32 will sniff PROBE REQUEST

config SNIFFING_TIME
	int "Time of sniffig in seconds"
	default 60
	help
		Time must be in seconds

config FILENAME1
	string "File name 1"
	default "/spiffs/probreq.log"
	help
		File name in which to save packet information. The path must be /spiffs/myfile.txt

config FILENAME2
	string "File name 2"
	default "/spiffs/probreq2.log"
	help
		File name in which to save packet information. The path must be /spiffs/myfile.txt
        
config VERBOSE
    int "Verbose mode"
    default 0
    range 0 1
    help
        Must be true (1) or false (0): if true more information will be printed

endmenu
```

## main/Kconfig.projbuild
```kconfig
menu "Configuration"

config WIFI_SSID
    string "WIFI name"
    default ""
    help
		SSID of WiFi (network name)

config WIFI_PSW
    string "Wifi password"
    default ""
    help
		WiFi password (WPA or WPA2), can be left blank if the network has no security set
		
config WIFI_CHANNEL
	int "Max channel range"
	range 1 13
	default 13
	help
		Channel in which ESP32 will sniff PROBE REQUEST

config WIFI_SNIFFING_TIME
	int "Time of sniffig in seconds"
	default 30
	help
		Time must be in seconds

config RSSI_Max
	int "RSSI_Max"
	default -90
	help
		

config PROBE_REQUEST
    int "Probe Request Sniffer"
    default 0
    range 0 1
    help
        Must be true (1) or false (0): if true only Probe Request is sniffed

config SSID
    int "SSID"
    default 0
    range 0 1
    help
        Must be true (1) or false (0): if true SSID will be catched. PROBE_REQUEST must be true (1)
		
config DEVICE_SIGNATURE
    int "Device Signature"
    default 0
    range 0 1
    help
        Must be true (1) or false (0): if true SSID will be catched. PROBE_REQUEST must be true (1)
		
config MQTT_SERVER_URI
  string "MQTT Server URI"
  default ""
  help
    The URI of the MQTT Server to publish to, ex: "mqtt://iot.eclipse.org"

config MQTT_PORT
  int "MQTT Server port"
  default 1883
  help
    The port of the MQTT Server to publish to, ex: 1883
	
config MQTT_TOPIC
  string "MQTT Topic under which all Data is published"
  default "esp32"
  help
		Name of main topic

config MQTT_USER
  string "MQTT username"
  default ""

config MQTT_PASS
  string "MQTT password"
  default ""		
  help
		Password of the MQTT server, can be left blank if the network has no security set

endmenu
```
